## arch/arm/configs/spmp30xx_defconfig
```kconfig
CONFIG_SYSVIPC=y
CONFIG_GENERIC_IRQ_DEBUGFS=y
CONFIG_NO_HZ=y
CONFIG_PREEMPT_VOLUNTARY=y
CONFIG_LOG_BUF_SHIFT=14
CONFIG_BLK_DEV_INITRD=y
CONFIG_INITRAMFS_SOURCE="rootfs.cpio.gz"
# CONFIG_RD_BZIP2 is not set
# CONFIG_RD_LZMA is not set
# CONFIG_RD_XZ is not set
# CONFIG_RD_LZO is not set
# CONFIG_RD_LZ4 is not set
# CONFIG_RD_ZSTD is not set
CONFIG_CC_OPTIMIZE_FOR_SIZE=y
# CONFIG_SYSFS_SYSCALL is not set
# CONFIG_BASE_FULL is not set
# CONFIG_AIO is not set
# CONFIG_IO_URING is not set
# CONFIG_ADVISE_SYSCALLS is not set
# CONFIG_RSEQ is not set
CONFIG_EMBEDDED=y
# CONFIG_VM_EVENT_COUNTERS is not set
CONFIG_SLOB=y
# CONFIG_ARCH_MULTI_V7 is not set
CONFIG_ARCH_INTEGRATOR=y
CONFIG_ARCH_INTEGRATOR_CP=y
CONFIG_ARCH_SPMP30XX=y
CONFIG_AEABI=y
CONFIG_FORCE_MAX_ZONEORDER=9
# CONFIG_ATAGS is not set
CONFIG_CMDLINE="console=ttyS0,115200n8"
CONFIG_CPU_FREQ=y
CONFIG_CPU_FREQ_DEFAULT_GOV_ONDEMAND=y
CONFIG_CPU_FREQ_GOV_POWERSAVE=y
CONFIG_CPU_FREQ_GOV_USERSPACE=y
CONFIG_CPU_FREQ_GOV_CONSERVATIVE=y
CONFIG_CPUFREQ_DT=y
# CONFIG_SUSPEND is not set
# CONFIG_SECCOMP is not set
# CONFIG_STACKPROTECTOR is not set
CONFIG_STRICT_KERNEL_RWX=y
CONFIG_PARTITION_ADVANCED=y
# CONFIG_MQ_IOSCHED_DEADLINE is not set
# CONFIG_COREDUMP is not set
CONFIG_CMA_AREAS=4
CONFIG_DEVTMPFS=y
CONFIG_DEVTMPFS_MOUNT=y
CONFIG_BLK_DEV_LOOP=y
CONFIG_BLK_DEV_RAM=y
CONFIG_BLK_DEV_RAM_SIZE=8192
# CONFIG_INPUT_KEYBOARD is not set
# CONFIG_INPUT_MOUSE is not set
# CONFIG_SERIO_SERPORT is not set
# CONFIG_VT is not set
# CONFIG_HW_RANDOM is not set
CONFIG_GPIO_PL061=y
# CONFIG_HID is not set
# CONFIG_USB_SUPPORT is not set
CONFIG_MMC=y
# CONFIG_PWRSEQ_EMMC is not set
# CONFIG_PWRSEQ_SIMPLE is not set
CONFIG_MMC_ARMMMCI=y
# CONFIG_VIRTIO_MENU is not set
# CONFIG_VHOST_MENU is not set
# CONFIG_IOMMU_SUPPORT is not set
CONFIG_EXT4_FS=y
# CONFIG_FILE_LOCKING is not set
CONFIG_MSDOS_FS=y
CONFIG_VFAT_FS=y
CONFIG_TMPFS=y
# CONFIG_MISC_FILESYSTEMS is not set
CONFIG_NLS_CODEPAGE_437=y
CONFIG_NLS_ISO8859_1=y
CONFIG_LSM="lockdown,yama,loadpin,safesetid,integrity,bpf"
# CONFIG_CRYPTO_HW is not set
CONFIG_CRC32_SLICEBY4=y
CONFIG_CMA_SIZE_MBYTES=0
CONFIG_PRINTK_TIME=y
CONFIG_DEBUG_FS=y
# CONFIG_DEBUG_MISC is not set
CONFIG_DEBUG_MEMORY_INIT=y
# CONFIG_FTRACE is not set
# CONFIG_RUNTIME_TESTING_MENU is not set
```

## arch/arm/mach-spmp30xx/Kconfig
```kconfig
# SPDX-License-Identifier: GPL-2.0-only
config ARCH_SPMP30XX
	bool "Sunplus SPMP30xx family"
	depends on ARCH_MULTI_V5
	select CPU_ARM926T
	select SPMP_INTC
	select SPMP_UART
	select SPMP_TIMER
	select GPIOLIB
	select GPIO_GENERIC_PLATFORM
	help
	  Support for the Sunplus SPMP30xx (3052, 3055, 3062) SoC family.
```

## drivers/soc/sunplus/Kconfig
```kconfig
# SPDX-License-Identifier: GPL-2.0-only
menu "Sunplus SoC drivers"

config SPMP30XX_SERIAL
	bool "Enable SPMP30xx serial driver"
	depends on SERIAL_CORE
	default ARCH_SPMP30XX
	help
	  Say yes to enable support for the serial driver found
	  in the Sunplus SPMP30xx SoC.

config SPMP30XX_SERIAL_EARLYCON
	bool
	depends on SPMP30XX_SERIAL
	select SERIAL_EARLYCON
	default y

endmenu
```
