## arch/arm/mach-ntr/Kconfig
```kconfig
menuconfig ARCH_NTR
	bool "Nintendo DS Handhelds"
	depends on CPU_LITTLE_ENDIAN && !MMU
	select OF
	select CPU_ARM946E
	help
	  This enables support for the Nintendo DS generation handhelds (NDS, DSi).

if ARCH_NTR

# SoC support
config SOC_NTR
    bool "Nintendo DS support (NTR)"
    depends on ARCH_NTR
    default y if ARCH_NTR
    help
      Enable basic support for the Nintendo DS (NTR) board and devices.

config SOC_TWL
	bool "Nintendo DSi support (TWL)"
	depends on ARCH_NTR
    depends on SOC_NTR
	default y if SOC_NTR
	help
	  Enable support for the extended DSi feature set (TWL SoC).

# Driver support

# Basic driver support (IRQs, timer, power management)
config NTR_IRQC
	bool "Nintendo DS interrupt controller driver"
	depends on SOC_NTR || COMPILE_TEST
	default y if SOC_NTR
	select IRQCHIP
	select GENERIC_IRQ_CHIP
	help
	  Support for the Nintendo DS (NTR) interrupt controller.

config TWL_IRQC
	bool "Nintendo DSi interrupt controller"
	depends on SOC_TWL
    depends on NTR_IRQC
	default y if SOC_TWL
	help
	  Support for the extended DSi (TWL) interrupts.

config NTR_TIMER
	bool "Nintendo DS family timer driver"
	depends on SOC_NTR
	default y if SOC_NTR
	select TIMER_OF
	select CLKSRC_MMIO
	select GENERIC_CLOCKEVENTS
	help
	  Enables support for the Nintendo DS generation timer hardware.


# Peripheral support (HID, I/O)
config NTR_SLOT1
    bool "Nintendo DS Slot-1 driver"
    depends on SOC_NTR
    default y if SOC_NTR
    help
      Support for the Nintendo DS Slot-1 connector,
      providing SPI and proprietary cartridge ROM ports.

config NTR_SLOT1_SPI
    bool "Nintendo DS Slot-1 SPI driver"
    depends on NTR_SLOT1
    default y if NTR_SLOT1
	select SPI
    help
      This enables support for the SPI bus in the Slot-1 connector.

config NTR_SLOT1_CARTROM
    bool "Nintendo DS Slot-1 Cartridge ROM driver"
    depends on NTR_SLOT1
    default y if NTR_SLOT1
    help
      This enables support for the ROM cartridge in the Slot-1 connector.


# Serial/debug device support
config NTR_DEBUG_EARLYCON
	bool "Early console using NTR/TWL no$gba debug port"
	depends on SOC_NTR || SOC_TWL
	select SERIAL_CORE
	select SERIAL_CORE_CONSOLE
	select SERIAL_EARLYCON
	default y if SOC_NTR
	help
	  Support for early debug console using the no$gba emulator debug port.
	  This enables the console before standard serial driver is probed. This
	  is enabled with "earlycon=ntr" on the kernel command line. The
	  console is enabled when early_param is processed.

config SERIAL_IS_SPI_USB_ADAPTER
	bool "IS-SPI-USB-ADAPTER serial port support"
	depends on SPI
	select SERIAL_CORE
	default y if ARCH_NTR
	help
	  Say Y here if you want to use the IS-SPI-USB-ADAPTER serial port over SPI.

	  The port will be available in /dev/ttyIS0.

# Multimedia support (video, audio)
# TODO

endif # ARCH_NTR
```
